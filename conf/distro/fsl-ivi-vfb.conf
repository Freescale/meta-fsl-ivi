## conf/distro/fsl-ivi-vfb.conf
```bitbake
# Freescale IVI Virtual Framebuffer support

# Override defaul distro features to remove x11
require ${COREBASE}/meta/conf/distro/defaultsetup.conf
DISTRO_FEATURES = "alsa argp bluetooth ext2 irda largefile pcmcia usbgadget usbhost wifi xattr nfs zeroconf pci 3g bluetooth systemd opengl ${DISTRO_FEATURES_LIBC}"

DISTRO_VERSION = "0.0.1"

VIRTUAL-RUNTIME_init_manager = "systemd"

include conf/distro/include/default-providers-ivi.inc

PREFERRED_VERSION_layer-management = "0.9.6"
```

## conf/distro/fsl-ivi-x.conf
```bitbake
DISTRO = "fsl-ivi-x"
DISTRO_NAME = "Yocto GENIVI Baseline (Poky/meta-ivi)"
DISTRO_VERSION = "6.0.2"
DISTRO_CODENAME ="horizon"

TARGET_VENDOR = "-poky"

LAYER_CONF_VERSION ?= "6"

include conf/distro/include/default-providers-ivi.inc

VIRTUAL-RUNTIME_init_manager = "systemd"
VIRTUAL-RUNTIME_initscripts = ""

DISTRO_FEATURES_append = " bluetooth systemd opengl pam"
DISTRO_FEATURES_BACKFILL_CONSIDERED = "sysvinit"

PREFERRED_PROVIDER_jpeg = "jpeg"
PREFERRED_PROVIDER_jpeg-native = "jpeg-native"

XSERVER = "xserver-xorg \
           xf86-input-evdev \
		   xf86-video-imxfb-vivante \
		   "
```

## conf/layer.conf
```bitbake
# We have a conf and classes directory, add to BBPATH
BBPATH .= ":${LAYERDIR}"

# We have a packages directory, add to BBFILES
BBFILES += "${LAYERDIR}/recipes-*/*/*.bb \
            ${LAYERDIR}/recipes-*/*/*.bbappend"

BBFILE_COLLECTIONS += "fsl-ivi"
BBFILE_PATTERN_fsl-ivi := "^${LAYERDIR}/"
BBFILE_PRIORITY_fsl-ivi = "7"

LAYER_CONF_VERSION = "6"
```
